## conf/layer.conf
```bitbake
# We have a conf and classes directory, add to BBPATH
BBPATH .= ":${LAYERDIR}"

# We have recipes-* directories, add to BBFILES
BBFILES += "${LAYERDIR}/recipes-*/*/*.bb \
            ${LAYERDIR}/recipes-*/*/*.bbappend"

BBFILE_COLLECTIONS += "mender-luks"
BBFILE_PATTERN_mender-luks = "^${LAYERDIR}/"

BBFILES_DYNAMIC += " \
  mender-legacy:recipes-mender/mender-client/mender-client_*.bb \
  mender-legacy:recipes-mender/mender-client/mender-client_*.bbappend \
"

INHERIT += "mender-luks-vars"

LAYERDEPENDS_mender-luks  = "   \
  core                          \
  mender                        \
  mender-kernel                 \
  bitbake-variable-substitution \
"

LAYERDEPENDS_mender-luks += "${@bb.utils.contains("DISTRO_FEATURES", "luks", "encrypted-storage", "", d)}"
LAYERDEPENDS_mender-luks += "${@bb.utils.contains("DISTRO_FEATURES", "tpm2", "tpm2"             , "", d)}"

LAYERSERIES_COMPAT_mender-luks = "wrynose"
```
